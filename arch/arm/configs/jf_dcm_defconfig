## arch/arm/configs/jf_dcm_defconfig
```kconfig
#
# for SC04E
#

CONFIG_MACH_JF_DCM=y
CONFIG_TARGET_LOCALE_JPN=y
CONFIG_EXTRA_FIRMWARE="audience-es325-fw.bin"
CONFIG_EXTRA_FIRMWARE_DIR="firmware"
CONFIG_WLAN_REGION_CODE=400
CONFIG_FB_MSM_MIPI_SAMSUNG_OCTA_VIDEO_FULL_HD_PT_PANEL=y
CONFIG_LCD_VDD3_BY_PMGPIO=y

CONFIG_CAMERA_SW_I2C=y
CONFIG_CAMERA_USE_GSBI7=y
CONFIG_IRDA_MC96=y
CONFIG_FELICA=y
CONFIG_NFC_FELICA=y
CONFIG_FELICA_NO_SECURE=y

CONFIG_CIFS=y
CONFIG_CP_ACCESS=y
CONFIG_MSM_RESET_MODEM=y
CONFIG_TCP_CONG_BIC=y
CONFIG_TCP_CONG_WESTWOOD=y
CONFIG_TCP_CONG_HTCP=y
```
